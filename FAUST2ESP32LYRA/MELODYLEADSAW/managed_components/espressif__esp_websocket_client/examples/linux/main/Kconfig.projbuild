## FAUST2ESP32LYRA/MELODYLEADSAW/managed_components/espressif__esp_websocket_client/examples/linux/main/Kconfig.projbuild
```kconfig
menu "Host-test config"

    config GCOV_ENABLED
        bool "Coverage analyzer"
        default n
        help
            Enables coverage analyzing for host tests.

    config WEBSOCKET_URI
          string "Websocket endpoint URI"
          default "ws://echo.websocket.events"
          help
              URL of websocket endpoint this example connects to and sends echo

endmenu
```

## FAUST2ESP32LYRA/MELODYLEADSAW/managed_components/espressif__esp_websocket_client/examples/target/main/Kconfig.projbuild
```kconfig
menu "Example Configuration"

    choice WEBSOCKET_URI_SOURCE
        prompt "Websocket URI source"
        default WEBSOCKET_URI_FROM_STRING
        help
            Selects the source of the URI used in the example.

        config WEBSOCKET_URI_FROM_STRING
            bool "From string"

        config WEBSOCKET_URI_FROM_STDIN
            bool "From stdin"
    endchoice

    config WEBSOCKET_URI
        string "Websocket endpoint URI"
        depends on WEBSOCKET_URI_FROM_STRING
        default "wss://echo.websocket.events"
        help
            URL of websocket endpoint this example connects to and sends echo

    config WS_OVER_TLS_SERVER_AUTH
        bool "Enable WebSocket over TLS with Server Certificate Verification Only"
        default y
        help
            Enables WebSocket connections over TLS (WSS) with server certificate verification.
            This setting mandates the client to verify the servers certificate, while the server
            does not require client certificate verification.

    config WS_OVER_TLS_MUTUAL_AUTH
        bool "Enable WebSocket over TLS with Server Client Mutual Authentification"
        default n
        help
            Enables WebSocket connections over TLS (WSS) with server and client mutual certificate verification.

    config WS_OVER_TLS_SKIP_COMMON_NAME_CHECK
        bool "Skip common name(CN) check during TLS authentification"
        default n
        help
            Skipping Common Name(CN) check during TLS(WSS) authentificatio

    if CONFIG_IDF_TARGET = "linux"
      config GCOV_ENABLED
          bool "Coverage analyzer"
          default n
          help
              Enables coverage analyzing for host tests.
      endif
endmenu
```

## FAUST2ESP32LYRA/SAWWAVE/managed_components/espressif__esp_websocket_client/Kconfig
```kconfig
menu "ESP WebSocket client"

    config ESP_WS_CLIENT_ENABLE_DYNAMIC_BUFFER
        bool "Enable websocket client dynamic buffer for send and receive data"
        default n
        help
            Enable this option will reallocated buffer when send or receive data and free them when end of use.
            This can save about 2 KB memory when no websocket data send and receive.

    config ESP_WS_CLIENT_SEPARATE_TX_LOCK
        bool "Enable separate tx lock for send and receive data"
        default n
        help
            Enable this option will use separate lock for send and receive data.
            This can avoid the lock contention when send and receive data at the same time.

    config ESP_WS_CLIENT_TX_LOCK_TIMEOUT_MS
        int "TX lock timeout in milliseconds"
        depends on ESP_WS_CLIENT_SEPARATE_TX_LOCK
        default 2000
        help
            Timeout for acquiring the TX lock when using separate TX lock.
endmenu
```

## examples/lyra/MELODYLEADSAW/managed_components/espressif__cmake_utilities/Kconfig
```kconfig
menu "CMake Utilities"
    
    config CU_RELINKER_ENABLE
        bool "Enable relinker"
        default n
        help
            "Enable relinker to linker some IRAM functions to Flash"

    if CU_RELINKER_ENABLE
        config CU_RELINKER_ENABLE_PRINT_ERROR_INFO_WHEN_MISSING_FUNCTION
            bool "Print error information when missing function"
            default y
            help
                "Enable this option to print error information instead of
                    throwing exception when missing function"

        config CU_RELINKER_ENABLE_CUSTOMIZED_CONFIGURATION_FILES
            bool "Enable customized relinker configuration files"
            default n
            help
                "Enable this option to use customized relinker configuration
                files instead of default ones"

        if CU_RELINKER_ENABLE_CUSTOMIZED_CONFIGURATION_FILES
            config CU_RELINKER_CUSTOMIZED_CONFIGURATION_FILES_PATH
                string "Customized relinker configuration files path"
                default ""
                help
                    "Customized relinker configuration files path. This path is
                    evaluated relative to the project root directory."
        endif
    endif

    choice CU_DIAGNOSTICS_COLOR
        prompt "Color in diagnostics"
        default CU_DIAGNOSTICS_COLOR_ALWAYS
        help
            Use color in diagnostics. "never", "always", or "auto". If "always", GCC will output
            with color defined in GCC_COLORS environment variable. If "never", only output plain
            text. If "auto", only output with color when the standard error is a terminal and when
            not executing in an emacs shell.

        config CU_DIAGNOSTICS_COLOR_NEVER
            bool "never"
        config CU_DIAGNOSTICS_COLOR_ALWAYS
            bool "always"
        config CU_DIAGNOSTICS_COLOR_AUTO
            bool "auto"
    endchoice

    config CU_GCC_LTO_ENABLE
        bool "Enable GCC link time optimization(LTO)"
        default n
        help
            "Enable this option, users can enable GCC link time optimization(LTO)
             feature for target components or dependencies.
    
    config CU_GCC_STRING_1BYTE_ALIGN
        bool "GCC string 1-byte align"
        default n
        help
            "Enable this option, user can make string in designated components align
             by 1-byte instead 1-word(4-byte), this can reduce unnecessary filled data
             so that to reduce firmware size."
endmenu
```

## examples/lyra/MELODYLEADSAW/sdkconfig.defaults
```kconfig
# Increase main task stack size for large Faust DSP objects
CONFIG_ESP_MAIN_TASK_STACK_SIZE=8192

# Enable C++ exceptions for std::bad_alloc handling
CONFIG_COMPILER_CXX_EXCEPTIONS=y
CONFIG_COMPILER_CXX_EXCEPTIONS_EMG_POOL_SIZE=256

# Optimize memory usage
CONFIG_ESP_SYSTEM_EVENT_TASK_STACK_SIZE=2048

# ---- PSRAM / SPIRAM settings (enable only if hardware has PSRAM present) ----
# Minimal safe defaults for ESP-IDF v5.x to initialize external SPI RAM
CONFIG_SPIRAM=y
CONFIG_SPIRAM_BOOT_INIT=y
# Use PSRAM for malloc (enables heap_caps in external memory)
CONFIG_SPIRAM_MALLOC_ALWAYSINTERNAL=0
# Do not automatically place BSS into PSRAM by default
CONFIG_SPIRAM_ALLOW_BSS_SEG_EXTERNAL_MEMORY=n
# Optional cache workaround for certain chips
CONFIG_SPIRAM_CACHE_WORKAROUND=y
```
